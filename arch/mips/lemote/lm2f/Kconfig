## arch/mips/lemote/lm2f/Kconfig
```kconfig
choice
	prompt "Machine type"
	depends on MACH_LM2F
	default LEMOTE_FULONG2F

config LEMOTE_FULONG2F
	bool "Lemote Fulong mini-PC"
	select ARCH_SPARSEMEM_ENABLE
	select CEVT_R4K
	select CSRC_R4K
	select SYS_HAS_CPU_LOONGSON2
	select DMA_NONCOHERENT
	select BOOT_ELF32
	select BOARD_SCACHE
	select HAVE_STD_PC_SERIAL_PORT
	select HW_HAS_PCI
	select I8259
	select ISA
	select IRQ_CPU
	select SYS_SUPPORTS_32BIT_KERNEL
	select SYS_SUPPORTS_64BIT_KERNEL
	select SYS_SUPPORTS_LITTLE_ENDIAN
	select SYS_SUPPORTS_HIGHMEM
	select SYS_HAS_EARLY_PRINTK
	select GENERIC_HARDIRQS_NO__DO_IRQ
	select GENERIC_ISA_DMA_SUPPORT_BROKEN
	select CPU_HAS_WB
	select CS5536
	help
	  Lemote Fulong mini-PC board based on the Chinese Loongson-2F CPU

config LEMOTE_2FNOTEBOOK
	bool "Lemote mini Notebook"
	select ARCH_SPARSEMEM_ENABLE
	select CEVT_R4K
	select CSRC_R4K
	select SYS_HAS_CPU_LOONGSON2
	select DMA_NONCOHERENT
	select BOOT_ELF32
	select BOARD_SCACHE
	select HAVE_STD_PC_SERIAL_PORT
	select HW_HAS_PCI
	select I8259
	select ISA
	select IRQ_CPU
	select SYS_SUPPORTS_32BIT_KERNEL
	select SYS_SUPPORTS_64BIT_KERNEL
	select SYS_SUPPORTS_LITTLE_ENDIAN
	select SYS_SUPPORTS_HIGHMEM
	select SYS_HAS_EARLY_PRINTK
	select GENERIC_HARDIRQS_NO__DO_IRQ
	select GENERIC_ISA_DMA_SUPPORT_BROKEN
	select CPU_HAS_WB
	select CS5536
	help
	  Lemote Notebook based on the Chinese Loongson-2F CPU

config LEMOTE_LYNLOONG_9003
	bool "Lemote LynLoong 9003"
	select ARCH_SPARSEMEM_ENABLE
	select CEVT_R4K
	select CSRC_R4K
	select SYS_HAS_CPU_LOONGSON2
	select DMA_NONCOHERENT
	select BOOT_ELF32
	select BOARD_SCACHE
	select HAVE_STD_PC_SERIAL_PORT
	select HW_HAS_PCI
	select ISA
	select IRQ_CPU
	select SYS_SUPPORTS_32BIT_KERNEL
	select SYS_SUPPORTS_64BIT_KERNEL
	select SYS_SUPPORTS_LITTLE_ENDIAN
	select SYS_SUPPORTS_HIGHMEM
	select SYS_HAS_EARLY_PRINTK
	select GENERIC_HARDIRQS_NO__DO_IRQ
	select GENERIC_ISA_DMA_SUPPORT_BROKEN
	select CPU_HAS_WB
	help
	 Lemote LynLoong 9003 based on the Chinese Loongson-2F CPU, this board use RTL8100SC_0, SM502,
 	 uPD720101GJ, VT6421A.

endchoice

config CS5536_RTC_BUG
	bool

config CS5536
	bool
	select CS5536_RTC_BUG

config LEMOTE_NAS
	bool "Lemote NAS machine"
	depends on LEMOTE_FULONG2F
	help 
	  Lemote's Loongson-2F based network attached system
```

## drivers/debug26/Config.in
```kconfig
#
# For a description of the syntax of this configuration file,
# see scripts/kbuild/config-language.txt.
#
config DEBUG26_DEBUG26
    tristate "debug26"
    default n
    help
		RAMDISK: ramdisk in 2.6 use initramfs,setup 2.6 kernel's menuconfig:
		          General setup>Initramfs source file(s)
				  g root=/dev/ram0 rdinit=/bin/bash
		NFS: setup boot params  nfsaddrs=10.0.0.12:::::eth0 nfsroot=10.0.0.3:/mnt/sdb2/debian
			 /etc/exports: /mnt/sdb2/newdebian  *(rw,async,no_root_squash)
		INSTALL DEBUG26 TO LINUX KERNEL 2.4:
		  cp -a debug26 linux/drivers
		  edit linux/Makefile
			+DRIVERS-$(CONFIG_DEBUG26) += drivers/debug26/mydebug.o

			DRIVERS := $(DRIVERS-y)

			menuconfig: include/linux/version.h symlinks
				$(MAKE) -C scripts/lxdialog all
				$(CONFIG_SHELL) scripts/Menuconfig arch/$(ARCH)/config.in
				+@if egrep "^CONFIG_DEBUG26=y" .config > /dev/null; then \
				+	$(MAKE) -C drivers/debug26 menuconfig; \
				+ fi
		  edit linux/drivers/Make
				+ sundir-$(CONFIG_DEBUG26)	+= debug26
		 
		INSTALL DEBUG26 TO LINUX KERNEL 2.6:
		  cp -a debug26 linux/drivers
		  edit linux/scripts/kconfig/Makefile
			menuconfig: $(obj)/mconf
				$(Q)$(MAKE) $(build)=scripts/lxdialog
				$< arch/$(ARCH)/Kconfig
			+	@if egrep "^CONFIG_DEBUG26=y" .config > /dev/null; then \
			+		$(MAKE)  obj=`pwd`/drivers/debug26 -C drivers/debug26 menuconfig; \
			+	 fi
		  edit linux/drivers/Make
			+obj-$(CONFIG_DEBUG26) += debug26/






choice
    prompt "kernel Type"
	depends on DEBUG26_DEBUG26
    default DEBUG26_LINUX26
	
	config DEBUG26_LINUX26
      bool "linux 2.6.*"
     
	config DEBUG26_LINUX24
      bool "linux 2.4.*"

endchoice

config  KERNEL_PATH
	string "linux kernel path"
	depends on DEBUG26_DEBUG26
	default "/usr/src/linux-2.4" if DEBUG26_LINUX24
	default "/usr/src/linux-2.6" if DEBUG26_LINUX26


config DEBUG26_MODULE_INSTALL
	bool "install module"
	depends on DEBUG26_DEBUG26=m
	default n

config DEBUG26_FROM_SERIAL
	bool "debug26 console form serial"
	default n

menu "debug26 functions"
	depends on DEBUG26_DEBUG26
config DEBUG26_RAMDISK
	bool "ramdisk"
	depends on DEBUG26_LINUX24
	default n
	help
	  ramdisk support.

config DEBUG26_RAMDISK_MYUNZIP
	bool "use my own unzip other than kernel initrd"
	depends on DEBUG26_RAMDISK
	default y
	help
		"use my own unzip other than kernel initrd"

config DEBUG26_RAMDISK_DIR
        string "ramdisk dir"
	depends on DEBUG26_RAMDISK
	default "/mnt/ramdisk"

config DEBUG26_RAMDISK_SIZE
	int "ramdisk size(K)"
	depends on DEBUG26_RAMDISK
	default 40960

config DEBUG26_LSMOUNT
	bool "lsmount"
	default n
	help
	  mount

config DEBUG26_CHROOT
	bool "chroot"
	default n
	help
	  mount

config DEBUG26_PCI
	bool "pci"
	default n
	help
	  pci support.

config DEBUG26_MEM
	bool "mem"
	default n
	help
	  pci support.

config DEBUG26_IO
	bool "io"
	default n
	help
	  pci support.

config DEBUG26_TEST
    bool "test"
    default n
    help
      mount

config DEBUG26_PAGER
    bool "pager"
    default n
    help
      mount

config DEBUG26_PWD
    bool "pwd"
    default n
    help
      mount

config DEBUG26_CD
    bool "cd"
    default n
    help
      mount

config DEBUG26_IFCONFIG
    bool "ifconfig"
    default n
    help
      mount

config DEBUG26_EXEC
    bool "exec"
    default n
    help
      mount

config DEBUG26_WRITEFILE
    bool "writefile"
    default n
    help
      mount


config DEBUG26_LS
	bool "ls"
	default n
	help
	  ls support.

config DEBUG26_DIFF
	bool "diff"
	default n
	help
		diff two file

config DEBUG26_PLX
	bool "plx"
	default n
	help
		plx device debug support

config DEBUG26_MYREQUEST_IRQ
	bool "myrequest_irq"
	default n
	help
		myrequest_irq thread for poll

config DEBUG26_DM642
	bool "dm642 debug tools support"
	default n
	help
	     dm642 debug tools support

endmenu


choice
    prompt "Subarchitecture Type"
	depends on DEBUG26_DEBUG26
    default DEBUG26_ARCH_I386

config DEBUG26_ARCH_I386
    bool "PC-compatible"
    help
      Choose this option if your computer is a standard PC or compatible.

config DEBUG26_ARCH_BONITO
    bool "ict nb2005(bonito)"
    help
      Choose this option if your board is nb2005 board

config DEBUG26_ARCH_EV64420
    bool "ict ev64420 board"
    help
      Choose this option if your board is nb2005 board

config DEBUG26_ARCH_8172
    bool "ict 8172 board"
    help
      Choose this option if your board is nb2005 board

endchoice

menu  "i386"
   depends on DEBUG26_DEBUG26 && DEBUG26_ARCH_I386
source i386/Config.in
endmenu

menu  "bonito"
   depends on DEBUG26_DEBUG26 && DEBUG26_ARCH_BONITO
source mips.bonito/Config.in
endmenu

menu  "ev64420"
   depends on DEBUG26_DEBUG26 && DEBUG26_ARCH_EV64420
source mips.ev64420/Config.in
endmenu


menu  "8172"
   depends on DEBUG26_DEBUG26 && DEBUG26_ARCH_8172
source mips.8172/Config.in
endmenu
```

## drivers/debug26/mips.bonito/Config.in
```kconfig
#
# For a description of the syntax of this configuration file,
# see scripts/kbuild/config-language.txt.
#

config DEBUG26_PNP_BONITO_686B
	bool "686b pnp"
	default n
	help

config DEBUG26_PNP_BONITO_82371
	bool "82371 pnp"
	default n
	help

config DEBUG26_TEST_BONITO
	bool "test"
	default n
	help

config DEBUG26_TEST_PMON
	bool "goto pmon"
	default n
	help

config DEBUG26_CS5536_I2C
    bool "cs5536's i2c"
	default n

config DEBUG26_I2C_88E1111
    bool "i2c rw 88e1111"
	default n

config DEBUG26_CS5536_GPIO
    bool "cs5536's gpio"
	default n
```

## drivers/debug26/mips.ev64420/Config.in
```kconfig
#
# For a description of the syntax of this configuration file,
# see scripts/kbuild/config-language.txt.
#

config DEBUG26_DUMPMV
	bool "dump ev64420"
	default n
	help

config DEBUG26_DUMP686B
	bool "dump 686b"
	default n
	help

config DEBUG26_TESTVGA
	bool "test vga"
	default n
	help

config DEBUG26_PNP_MV
	bool "pnp"
	default n
	help
```

## drivers/debug26/test/Config.in
```kconfig
#
# For a description of the syntax of this configuration file,
# see scripts/kbuild/config-language.txt.
#
config DEBUG26_DEBUG26
    tristate "debug26"
    default n
    help
      ramdisk support.
	  NFS: setup boot params  nfsaddrs=10.0.0.12:10.0.0.3 nfsroot=10.0.0.3:/mnt/sdb2/debian
config MODULE
	tristate "MODULE"
	default n

menu "debug26 functions"
	depends on DEBUG26_DEBUG26
config DEBUG26_RAMDISK
	bool "ramdisk"
	default n
	help
	  ramdisk support.

config DEBUG26_LSMOUNT
	bool "lsmount"
	default n
	help
	  mount

config DEBUG26_CHROOT
	bool "chroot"
	default n
	help
	  mount

config DEBUG26_PCI
	bool "pci"
	default n
	help
	  pci support.

config DEBUG26_MEM
	bool "mem"
	default n
	help
	  pci support.

config DEBUG26_IO
	bool "io"
	default n
	help
	  pci support.

config DEBUG26_TEST
    bool "test"
    default n
    help
      mount

config DEBUG26_PAGER
    bool "pager"
    default n
    help
      mount

config DEBUG26_PWD
    bool "pwd"
    default n
    help
      mount

config DEBUG26_CD
    bool "cd"
    default n
    help
      mount

config DEBUG26_IFCONFIG
    bool "ifconfig"
    default n
    help
      mount

config DEBUG26_EXEC
    bool "exec"
    default n
    help
      mount

config DEBUG26_WRITEFILE
    bool "writefile"
    default n
    help
      mount


config DEBUG26_LS
	bool "ls"
	default n
	help
	  ls support.


endmenu


choice
    prompt "Subarchitecture Type"
	depends on DEBUG26_DEBUG26
    default DEBUG26_ARCH_I386

config DEBUG26_ARCH_I386
    bool "PC-compatible"
    help
      Choose this option if your computer is a standard PC or compatible.

config DEBUG26_ARCH_BONITO
    bool "ict nb2005(bonito)"
    help
      Choose this option if your board is nb2005 board

config DEBUG26_ARCH_EV64420
    bool "ict ev64420 board"
    help
      Choose this option if your board is nb2005 board

config DEBUG26_ARCH_8172
    bool "ict 8172 board"
    help
      Choose this option if your board is nb2005 board

endchoice

menu  "i386"
   depends on DEBUG26_DEBUG26 && DEBUG26_ARCH_I386
source i386/Config.in
endmenu

menu  "bonito"
   depends on DEBUG26_DEBUG26 && DEBUG26_ARCH_BONITO
source mips.bonito/Config.in
endmenu

menu  "ev64420"
   depends on DEBUG26_DEBUG26 && DEBUG26_ARCH_EV64420
source mips.ev64420/Config.in
endmenu


menu  "8172"
   depends on DEBUG26_DEBUG26 && DEBUG26_ARCH_8172
source mips.8172/Config.in
endmenu
```

## drivers/misc/loongson/Kconfig
```kconfig
#
# Yeeloong various drivers
#
menuconfig LOONGSON2_PLATFROM_SUPPORT
	bool "Loongson Platfrom Drivers Support"
	depends on CPU_LOONGSON2
	default y
	help
	 Say Y here to enable support various drivers on the loongson2 platfrom	

if LOONGSON2_PLATFROM_SUPPORT

config EC_COMMON_OPERATION
	bool "Yeeloong laptop EC common operation support"
	depends on LEMOTE_2FNOTEBOOK
	default y
	help
	 Suspend code needs these operations, so buildin the kernel. 
	 Say Y here to enable it


config EC_ROM_UPDATE_DRIVER
	tristate "EC update driver"
	depends on EC_COMMON_OPERATION
	default m
	help 
	 Say Y here to enable support ec rom update driver

config EC_SCI_DRIVER
	tristate "EC SCI driver"
	depends on EC_COMMON_OPERATION
	default m
	help
	 Say Y here to support ec sci event driver 

config LAPTOP_YEELOONG
	tristate "Yeeloong laptop drivers"
	depends on EC_COMMON_OPERATION
	select BACKLIGHT_CLASS_DEVICE
	select HWMON
	select POWER_SUPPLY
	select THERMAL
	select VIDEO_OUTPUT_CONTROL
	default m
	help
	 Include backlight control,fan speed set,hardmare monitor, input event,
	 battery status and so on. Say Y or M here to enable it	

config LYNLOONG_9003_BACKLIGHT 
	tristate "Lynloong 9003 backlight driver"
	depends on LEMOTE_LYNLOONG_9003 
	select BACKLIGHT_CLASS_DEVICE
	default m
	help
	 Backlight control driver for Lynloong 9003. Say Y or M here to enable it

config BIOS_DRIVER
	tristate "BIOS update driver"
	select MTD
	default m
	help
	 Update yeeloong laptop BIOS driver, enable it to say M or Y  
config IO_MSR_DEBUG_DRIVER
	tristate "IO_MSR_DEBUG_DRIVER"
	default n
	help
	 Debug system to use wrsmr and rdmsr which used to access the CS5536.
endif  #LOONGSON2_PLATFROM_SUPPORT
```
